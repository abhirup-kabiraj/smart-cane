#include <PCM.h>
String a;
int x1=7,y1=8;
const unsigned char up[] PROGMEM = {
  126, 125, 125, 125, 125, 125, 124, 124, 124, 125, 126, 126,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 135, 
  };
  const unsigned char down[] PROGMEM = {
  129, 129, 128, 128, 126, 125, 126, 127, 125, 124, 124, 125,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 124, 
  };





int trig=10;
int echo=9;
double dur;
double dist;

//not used yet
int trig2=6;
int echo2=5;
double dur2;
double dist2;

int lightpin=A3;
int buzzpin=12;
int x=3;
int y=4;
void setup() {
    // put your setup code here, to run once:
    Serial.begin(9600);
    pinMode(trig,OUTPUT);
    pinMode(echo,INPUT);
    pinMode(buzzpin,OUTPUT);
    pinMode(lightpin,OUTPUT);
    //digitalWrite(2,LOW);

    startPlayback(up, sizeof(up));
  pinMode(x1,INPUT);
  pinMode(y1,INPUT);
    pinMode(trig2,OUTPUT);
    pinMode(echo2,INPUT);
    pinMode(buzzpin,OUTPUT);
   
}

void loop() {

  digitalWrite(trig,HIGH);
  delayMicroseconds(10);
  digitalWrite(trig,LOW);
  delayMicroseconds(10);
  dur=pulseIn(echo,HIGH);
  dist=(340.*dur)/20000.;
  Serial.println("FRONT DISTANCE");
  Serial.println(dist);
  delay(400);
  checkfront();
  //void
  
  
  digitalWrite(trig2,HIGH);
  delayMicroseconds(10);
  digitalWrite(trig2,LOW);
  delayMicroseconds(10);
  dur2=pulseIn(echo2,HIGH);
  //Serial.println(dur2);
  dist2=(340.*dur2)/20000.;
  Serial.println("low dist");
  Serial.println(dist2);
  delay(400);
  //void 
  checkforstair();
  digitalWrite(y,LOW);
  //void 
  checkforhole();
  digitalWrite(x,LOW);
}

void checkforstair()
{
  
  if(dist2<30 )
  {
    startPlayback(up, sizeof(up));
    digitalWrite(y,HIGH);
    Serial.println("DANGER!!!! STAIRS IN FRONT");
    digitalWrite(lightpin,HIGH);
    delay(dist2*50);
    digitalWrite(lightpin,LOW);
  }
  else if(dist2<40)
  {
    startPlayback(up, sizeof(up));
    digitalWrite(y,HIGH);
    Serial.println("DANGER!!!! STAIRS IN FRONT");
    digitalWrite(lightpin,HIGH);
    delay(200);
    digitalWrite(lightpin,LOW);
  }
}
void checkforhole()
{
  if(dist2>75 )
  {
      startPlayback(down, sizeof(down));
    digitalWrite(x,HIGH);
    Serial.println("DANGER!!!! HOLE IN FRONT");
    digitalWrite(lightpin,HIGH);
    delay(dist2*50);
    digitalWrite(lightpin,LOW);
  }
  else if(dist2>80)
  {
      startPlayback(down, sizeof(down));
    digitalWrite(x,HIGH);
    Serial.println("DANGER!!!! HOLE IN FRONT");
    digitalWrite(lightpin,HIGH);
    delay(200);
    digitalWrite(lightpin,LOW);
  }
}

void checkfront()
{
  if(dist<70 && dist>4)
  {
    Serial.println("DANGER!!!! OBJECT INFRONT TOO CLOSE");
    digitalWrite(buzzpin,HIGH);
    delay(dist*50);
    digitalWrite(buzzpin,LOW);
    delay(dist*30);
  }
  else if(dist<85)
  {
    Serial.println("DANGER!!!! OBJECT INFRONT TOO CLOSE");
    digitalWrite(buzzpin,HIGH);
    delay(400);
    digitalWrite(buzzpin,LOW);
  }
}
